## build/Kconfig/arch/Kconfig
```kconfig
# Load Zephyr Arch Kconfig descriptions.
osource "/home/gusta/zephyrproject/zephyr/arch/rx/Kconfig"
osource "/home/gusta/zephyrproject/zephyr/arch/x86/Kconfig"
osource "/home/gusta/zephyrproject/zephyr/arch/xtensa/Kconfig"
osource "/home/gusta/zephyrproject/zephyr/arch/sparc/Kconfig"
osource "/home/gusta/zephyrproject/zephyr/arch/riscv/Kconfig"
osource "/home/gusta/zephyrproject/zephyr/arch/posix/Kconfig"
osource "/home/gusta/zephyrproject/zephyr/arch/openrisc/Kconfig"
osource "/home/gusta/zephyrproject/zephyr/arch/mips/Kconfig"
osource "/home/gusta/zephyrproject/zephyr/arch/arm64/Kconfig"
osource "/home/gusta/zephyrproject/zephyr/arch/arm/Kconfig"
osource "/home/gusta/zephyrproject/zephyr/arch/arc/Kconfig"
```

## build/Kconfig/boards/Kconfig
```kconfig
# Load Zephyr board Kconfig descriptions.
osource "/home/gusta/zephyrproject/zephyr/boards/st/nucleo_f767zi/Kconfig"
```

## build/Kconfig/boards/Kconfig.defconfig
```kconfig
# Load Zephyr board defconfig descriptions.
osource "/home/gusta/zephyrproject/zephyr/boards/st/nucleo_f767zi/Kconfig.defconfig"
```

## build/Kconfig/boards/Kconfig.nucleo_f767zi.tmp
```kconfig
# Load board Kconfig descriptions.
osource "/home/gusta/zephyrproject/zephyr/boards/st/nucleo_f767zi/Kconfig.nucleo_f767zi"
```
